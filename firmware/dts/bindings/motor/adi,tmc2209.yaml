## firmware/dts/bindings/motor/ll,servo.yaml
```yaml
description: |
  Servo motor controller using STM32 timer peripheral

compatible: ll,servo

include:
  - name: base.yaml
  - name: pinctrl-device.yaml

properties:
  pinctrl-0:
    required: true

  pinctrl-names:
    required: true

  pwm-channel:
    type: int
    required: true
```

## firmware/dts/bindings/motor/ll,stepper-power.yaml
```yaml
description: |
  Shared stepper driver enable and the drivers' DIAG outputs, polled by the motor motion library

compatible: ll,stepper-power

include:
  - name: base.yaml

properties:
  enable-gpios:
    type: phandle-array
    required: true
    description: Shared enable of the stepper drivers.
  diag-gpios:
    type: phandle-array
    required: true
    description: DIAG output of each stepper driver, in motor id order.
```

## firmware/dts/bindings/motor/ll,stepper.yaml
```yaml
description: |
  Stepper motor controller using STM32 timer peripheral

compatible: ll,stepper

include:
  - name: base.yaml
  - name: pinctrl-device.yaml


properties:
  dir-gpios:
    type: phandle-array
    required: true
  pwm-channel:
    type: int
    required: true
  limit-switch-gpios:
    type: phandle-array
    required: false
  driver-dev:
    type: phandle
    required: false
```

## firmware/dts/bindings/pressure_sensor/ll,pressure-sensor.yaml
```yaml
description: |
  Pressure Sensor using ADC peripherals

compatible: "ll,pressure-sensor"

include:
  - name: base.yaml

properties:
  io-channels:
    type: phandle-array
    required: true
    description: ADC peripheral instance and channel number
  sample-rate:
    type: int
    required: true
    description: The rate at which the pressure sensor is sampled
```

## firmware/dts/bindings/pressure_sensor/ll,pressure_sensor.yaml
```yaml
description: |
  Pressure Sensor using ADC peripherals

compatible: "ll,pressure-sensor"

include:
  - name: base.yaml

properties:
  adc:
    type: phandle
    required: true
    description: ADC peripheral instance
  adc-channel:
    type: int
    required: true
    description: ADC channel number
  sample-rate:
    type: int
    required: true
    description: The rate at which the pressure sensor is sampled
```

## firmware/dts/bindings/tone_generator/ll,tone_generator.yaml
```yaml
description: |
  Tone generator using STM32 DMA, DAC, and timer peripherals

compatible: "ll,tone-generator"

include:
  - name: base.yaml

properties:
  sample-rate-timer:
    type: phandle
    required: true
    description: TIM peripheral instance for generating sample rate

  dac:
    type: phandle
    required: true
    description: DAC peripheral instance for outputting waveform

  dac-channel:
    type: int
    required: true
    enum: [1, 2]
    description: DAC peripheral channel for outputting waveform

  dmas:
    type: phandle-array
    required: true
    description: DMAMUX instance, channel, request line, and priority

  enable-gpios:
    type: phandle-array
    required: true
    description: Enable pin for the speaker amplifier
```

## firmware/lib/fft/Kconfig
```kconfig
menuconfig LIB_FFT
    bool "Enable FFT support"
    default n
    select CMSIS_DSP
    select CMSIS_DSP_COMPLEXMATH
    select CMSIS_DSP_TRANSFORM
    help
      Enable the library that calculates FFTs

config LIB_FFT_SHELL
    bool "Enable the shell for the FFT library"
    default n
    select SHELL
    select LIB_FFT
    select LL_GENERIC_GPIO
    help
      Enable the shell for testing the FFT support library
```

## firmware/lib/jerrycan/Kconfig
```kconfig
menuconfig LIB_JERRYCAN
    bool "Enable the JerryCAN library"
    default n
    help
      Enable the library that handles CAN communication for the the MouseGym system.

menuconfig LIB_JERRYCAN_STATUS_TX_RATE
    int "Status TX Rate"
    default 1000
    depends on LIB_JERRYCAN
    help
      The rate at which the status message is transmitted in milliseconds.

menuconfig LIB_JERRYCAN_TEMPERATURE_TX_RATE
    int "Temperature TX Rate"
    default 1000
    depends on LIB_JERRYCAN
    help
      The rate at which the temperature message is transmitted in milliseconds.

menuconfig LIB_JERRYCAN_SHELL
    bool "Enable the shell for the JerryCAN library"
    default n
    depends on LIB_JERRYCAN
    depends on SHELL
    depends on CAN
    help
      Enable the shell for the JerryCAN library

menuconfig LIB_JERRYCAN_INIT_PRIORITY
    int "Initialization Priority"
    default 91
    depends on LIB_JERRYCAN
    help
      The initialization priority of the JerryCAN library.
```

## firmware/lib/motor_motion/Kconfig
```kconfig
menuconfig LIB_MOTOR_MOTION
    bool "Enable the motor motion mathematics library"
    default n
    depends on FPU
    select SETTINGS
    select LL_SERVO if DT_HAS_LL_SERVO_ENABLED
    select LL_STEPPER if DT_HAS_LL_STEPPER_ENABLED
    depends on LIB_MOTOR_MOTION_WORK_QUEUE_PRIORITY < 0
    depends on LIB_MOTOR_MOTOIN_SETTINGS_WORK_QUEUE_PRIORITY > 90
    depends on LIB_MOTOR_MOTION_WORK_QUEUE_STACK_SIZE > 0
    depends on LIB_MOTOR_MOTION_SETTINGS_WORK_QUEUE_STACK_SIZE > 0
    help
      Enable the library that calculates motor motion based on sinusoidal motion profiles.

menuconfig LIB_MOTOR_MOTION_LOG_LEVEL
    int "Log level for the motor motion mathematics library"
    default 4
    depends on LIB_MOTOR_MOTION
    help
      Set the log level for the motor motion math library.

menuconfig LIB_MOTOR_MOTION_SHELL
    bool "Enable the shell for the motor motion mathematics library"
    default n
    depends on LIB_MOTOR_MOTION
    help
      Enable the shell for the motor motion math library

config LIB_MOTOR_MOTION_WORK_QUEUE_PRIORITY
  int "Thread priority for the motor motion work queue"
  default 0
  range -16 0

config LIB_MOTOR_MOTION_SETTINGS_WORK_QUEUE_PRIORITY
  int "Thread priority for background settings saves"
  default 89
  range 89 99

config LIB_MOTOR_MOTION_WORK_QUEUE_STACK_SIZE
  int "Work queue thread stack size"
  default 0

config LIB_MOTOR_MOTION_SETTINGS_WORK_QUEUE_STACK_SIZE
  int "Settings work queue thread stack size"
  default 0
```

## firmware/west.yml
```yaml
manifest:
  defaults:
    remote: zephyrproject
  remotes:
    - name: zephyrproject
      url-base: https://github.com/zephyrproject-rtos
  group-filter: [+optional]
  projects:
    - name: zephyr
      repo-path: zephyr
      revision: v3.7.0-rc2
      clone-depth: 1
      import:
        path-prefix: deps
        name-allowlist:
          - cmsis
          - hal_stm32
          - mcuboot
          - mbedtls
```
