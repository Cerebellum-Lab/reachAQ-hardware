## firmware/boards/arm/cerebellumlab_magnet_module/Kconfig.defconfig
```kconfig
if BOARD_CEREBELLUMLAB_MAGNET_MODULE

config SPI_STM32_INTERRUPT
	default y
	depends on SPI

endif # BOARD_CEREBELLUMLAB_MAGNET_MODULE
```

## firmware/boards/arm/cerebellumlab_magnet_module/board.yml
```yaml
board:
  name: cerebellumlab_magnet_module
  vendor: cerebellumlab
  socs:
    - name: stm32g474xx
```

## firmware/boards/arm/cerebellumlab_pellet_module/board.yml
```yaml
board:
  name: cerebellumlab_pellet_module
  vendor: cerebellumlab
  socs:
    - name: stm32g474xx
```

## firmware/drivers/Kconfig
```kconfig
rsource "gpio/Kconfig"
rsource "motor/Kconfig"
rsource "tone_generator/Kconfig"
rsource "pressure_sensor/Kconfig"
rsource "load_cell/Kconfig"
rsource "analog_status/Kconfig"
```

## firmware/drivers/analog_out/Kconfig
```kconfig
config LL_ANALOG_OUT_LOG_LEVEL
    int "Log level (0-4)"
        default 4
        help
            Set the log level for the analog output driver

config LL_ANALOG_OUT_INIT_PRIORITY
        int "Initialization priority"
        default 91
        help
            Set the initialization priority for the analog output driver

menuconfig LL_ANALOG_OUT
        bool "Support LeafLabs analog output driver"
        default y
        depends on DT_HAS_LL_ANALOG_OUT_ENABLED
        select DAC
        help
            Enable support for the analog output driver

config LL_ANALOG_OUT_SHELL
        bool "Enable shell commands for analog output driver"
        default y
        depends on SHELL
        depends on LL_ANALOG_OUT
        help
            Enable shell commands for analog output driver
```

## firmware/drivers/analog_status/Kconfig
```kconfig
config LL_ANALOG_STATUS_LOG_LEVEL
    int "Log level (0-4)"
        default 4
        help
            Set the log level for the analog status driver

config LL_ANALOG_STATUS_INIT_PRIORITY
        int "Initialization priority"
        default 91
        help
            Set the initialization priority for the analog status driver

menuconfig LL_ANALOG_STATUS
        bool "Support LeafLabs analog status driver"
        default y
        depends on DT_HAS_LL_ANALOG_STATUS_ENABLED
        select DAC
        help
            Enable support for the analog status driver

config LL_ANALOG_STATUS_SHELL
        bool "Enable shell commands for analog status driver"
        default y
        depends on SHELL
        depends on LL_ANALOG_STATUS
        help
            Enable shell commands for analog status driver
```

## firmware/drivers/gpio/Kconfig
```kconfig
config LL_GENERIC_GPIO_LOG_LEVEL
    int "Log level (0-4)"
        default 4
        help
            Set the log level for generic GPIO driver

menuconfig LL_GENERIC_GPIO
        bool "Support LeafLabs generic GPIO driver"
        default y
        depends on DT_HAS_LL_GENERIC_GPIOS_ENABLED
        help
            Enable support the simple generic gpio driver

config LL_GENERIC_GPIO_SHELL
        bool "Enable shell commands for generic GPIO driver"
        default y
        depends on SHELL
        depends on LL_GENERIC_GPIO
        help
            Enable shell commands for generic GPIO driver
```

## firmware/drivers/load_cell/Kconfig
```kconfig
config LL_LOAD_CELL_LOG_LEVEL
        int "Log level (0-4)"
        default 4
        help
            Set the log level for the load cell

config LL_LOAD_CELL_INIT_PRIORITY
        int "Initialization priority"
        default 91
        help
            Set the initialization priority for the load cell

menuconfig LL_LOAD_CELL
        bool "Support LeafLabs load cell driver"
        default y
        depends on DT_HAS_LL_LOAD_CELL_ENABLED
        select I2C
        select GPIO
        help
            Enable support for the load cell

config LL_LOAD_CELL_SHELL
        bool "Enable shell commands for load cell driver"
        default y
        depends on SHELL
        depends on LL_LOAD_CELL
        help
            Enable shell commands for load cell driver
```

## firmware/drivers/microphone/Kconfig
```kconfig
config LIB_MIC_LOG_LEVEL
    int "Log level (0-4)"
        default 4
        help
            Set the log level for generic GPIO driver

menuconfig LIB_MIC
        bool "Support Magnet Module microphone capability"
        default y
        select I2S
        select CONFIG_I2S_STM32
        depends on DT_HAS_LL_MICROPHONE_ENABLED
        help
           Enable support for the magnet module microphone

config LIB_MIC_SHELL
        bool "Enable shell commands for magnet module microphone"
        default n
        depends on SHELL
        depends on LIB_MIC
        help
            Enable shell commands for magnet module microphone
```

## firmware/drivers/motor/Kconfig.adi_tmc2209
```kconfig
menuconfig ADI_TMC2209
        bool "Support Analog Devices, Inc. TMC2209 Stepper Motor Driver"
        default y
        depends on DT_HAS_ADI_TMC2209_ENABLED
        select UART
        select PIPES
        help
            Enable support for the Analog Devices TMC2209 Stepper Motor Driver

menuconfig ADI_TMC2209_SHELL
        bool "Support shell for Analog Devices, Inc. TMC2209 Stepper Motor Driver"
        default n
        depends on ADI_TMC2209
        depends on SHELL
        help
            Enable shell support for the Analog Devices TMC2209 Stepper Motor Driver

config ADI_TMC2209_DEBUG_LEVEL
        int "Log Level [0,4]"
        default 1
```

## firmware/drivers/motor/Kconfig.servo
```kconfig
menuconfig LL_SERVO
        bool "Support LeafLabs servo driver"
        default y
        depends on DT_HAS_LL_SERVO_ENABLED
        select USE_STM32_LL_TIM
        select DMA
        help
            Enable support for the servo driver

config LL_SERVO_SHELL
        bool "Enable shell commands for servo driver"
        default y
        depends on LL_SERVO
        depends on SHELL
        help
            Enable shell commands for the servo driver
```

## firmware/drivers/motor/Kconfig.stepper
```kconfig
menuconfig LL_STEPPER
        bool "Support LeafLabs stepper driver"
        default y
        depends on GPIO
        depends on DT_HAS_LL_STEPPER_ENABLED
        depends on ADI_TMC2209
        select USE_STM32_LL_TIM
        select DMA
        help
            Enable support for the stepper driver
```

## firmware/drivers/pressure_sensor/Kconfig
```kconfig
config LL_PRESSURE_SENSOR_LOG_LEVEL
    int "Log level (0-4)"
        default 4
        help
            Set the log level for the pressure sensor

config LL_PRESSURE_SENSOR_INIT_PRIORITY
        int "Initialization priority"
        default 91
        help
            Set the initialization priority for the pressure sensor

menuconfig LL_PRESSURE_SENSOR
        bool "Support LeafLabs pressure sensor driver"
        default y
        depends on DT_HAS_LL_PRESSURE_SENSOR_ENABLED
        select USE_STM32_LL_GPIO
        select ADC
        select ADC_ASYNC
        select DMA
        help
            Enable support for the pressure sensor

config LL_PRESSURE_SENSOR_SHELL
        bool "Enable shell commands for pressure sensor driver"
        default y
        depends on SHELL
        depends on LL_PRESSURE_SENSOR
        help
            Enable shell commands for pressure sensor
```

## firmware/drivers/tone_generator/Kconfig
```kconfig
config LL_TONE_GENERATOR_LOG_LEVEL
    int "Log level (0-4)"
        default 4
        help
            Set the log level for the tone generator

config LL_TONE_GENERATOR_INIT_PRIORITY
        int "Initialization priority"
        default 91
        help
            Set the initialization priority for the tone generator

menuconfig LL_TONE_GENERATOR
        bool "Support LeafLabs tone generator driver"
        default y
        depends on DT_HAS_LL_TONE_GENERATOR_ENABLED
        select USE_STM32_LL_TIM
        select USE_STM32_LL_DAC
        select DMA
        help
            Enable support for the tone generator

config LL_TONE_GENERATOR_SHELL
        bool "Enable shell commands for tone generator driver"
        default y
        depends on LL_TONE_GENERATOR
        help
            Enable shell commands for tone generator driver
```

## firmware/dts/bindings/analog_out/ll,analog-out.yaml
```yaml
description: |
  Analog output using DAC peripheral.

compatible: "ll,analog-out"

include:
  - name: base.yaml

properties:
  io-channels:
    type: phandle-array
    required: true
    description: DAC peripheral instance and channel for outputting analog output
  
  resolution:
    type: int
    required: true
    enum: [8, 10, 12]
    default: 12
    description: DAC resolution, in bits
```

## firmware/dts/bindings/analog_status/ll,analog-status.yaml
```yaml
description: |
  Analog status output using DAC peripheral.

compatible: "ll,analog-status"

include:
  - name: base.yaml

properties:
  io-channels:
    type: phandle-array
    required: true
    description: DAC peripheral instance and channel for outputting analog status
  
  resolution:
    type: int
    required: true
    enum: [8, 10, 12]
    default: 12
    description: DAC resolution, in bits
```

## firmware/dts/bindings/gpio/ll,generic-gpios.yaml
```yaml
description: |
  Simple collection of GPIOs for simple things

compatible: "ll,generic-gpios"

include: base.yaml

properties:
  input-gpios:
    type: phandle-array
  input-gpio-names:
    type: string-array
  input-gpio-interrupt-enable:
    type: string-array
# Future, if string-array of enumerations are supported
#    enum:
#    - DISABLE
#    - RISING
#    - FALLING
#    - BOTH
    description: Array of interrupt enable states for each input GPIO. Valid values DISABLE, RISING, FALLING, or BOTH
  output-gpios:
    type: phandle-array
  output-gpio-names:
    type: string-array
  output-gpio-interrupt-enable:
    type: string-array
  pulse-enable-gpio-names:
    type: string-array
    description: |
      Names of the pins that may be driven by JERRYCAN_CMD_GPIO_PULSE, the finite
      firmware-timed digital pulse. Omitting the property refuses every pulse, so a
      board has to opt a line in deliberately. Do not list a pin another driver also
      drives: on the pellet board STIM0 and STIM1 are the tone generator's TTL
      confirmations and a pulse there would contend with them.
```

## firmware/dts/bindings/ll,device-id-gpios.yaml
```yaml
description: |
  Simple collection of GPIOs that describe a device type and the node id

compatible: "ll,device-id-gpios"

include: base.yaml

properties:
  device-type-gpios:
    type: phandle-array
    required: true
  node-number-gpios:
    type: phandle-array
    required: true
```

## firmware/dts/bindings/ll,stim-gpios.yaml
```yaml
description: |
  Simple collection of GPIOs to be used for stim outputs

compatible: "ll,stim-gpios"

include: base.yaml

properties:
  stim-gpios:
    type: phandle-array
    required: true
```

## firmware/dts/bindings/load_cell/ll,load-cell.yaml
```yaml
description: |
  Load cell driver on I2C bus using NAU7802 24-bit ADC

compatible: "ll,load-cell"

include:
  - name: base.yaml
  - name: sensor-device.yaml
  - name: i2c-device.yaml

properties:
  adc-channel:
    type: int
    required: true
    enum: [1, 2]
    default: 1
    description: NAU7802 24-bit ADC channel connected to load cell
  ldo-voltage:
    type: string
    required: true
    enum:
      - "4V5"
      - "4V2"
      - "3V9"
      - "3V6"
      - "3V3"
      - "3V0"
      - "2V7"
      - "2V4"
    default: "2V4"
    description: NAU7802 Internal LDO Output Voltage (AVDD) - Must not exceed VDD-0.3V
  gain:
    type: int
    required: true
    enum: 
      - 1
      - 2
      - 4
      - 8
      - 16
      - 32
      - 64
      - 128
    default: 1
    description: NAU7802 Gain Selection
  conversion-rate:
    type: int
    required: true
    enum:
      - 10
      - 20
      - 40
      - 80
      - 320
    default: 10
    description: NAU7802 Conversion Rate in samples-per-second
  drdy-gpios:
    type: phandle-array
    required: true
    description: NAU7802 DRDY interrupt pin
```

## firmware/dts/bindings/microphone/ll,microphone.yaml
```yaml
description: |
  Microphone on the I2S bus

compatible: ll,microphone

include:
  - name: base.yaml
  - name: i2s-device.yaml

properties:
  sampling-frequency:
    type: int
    required: true
    description: Sample frequency of microphone input.
  channel-count:
    type: int
    required: true
    description: Number of input channels.
  block-size:
    type: int
    required: true
    description: Size of blocks to read from microphone. As blocks are subjected to FFT, but be in range [16..4096], powers of two.
```
